
.CSEG

.ORG 0x800
;Row 0 data:
;       
 .db  0b10000011, 0b11110111, 0b10000011, 0b10000011, 0b11111011, 0b10000001, 0b10000011, 0b10000001, 0b10000011, 0b10000011, 0b10000011, 0b00000011, 0b10000011, 0b00000011, 0b00000001, 0b00000001
 .db  0b10000011, 0b01111101, 0b10000011, 0b11000011, 0b01110111, 0b01111111, 0b00111001, 0b01111101, 0b10000011, 0b00000011, 0b10000011, 0b00000011, 0b10000001, 0b00000001, 0b01111101, 0b01111101
 .db  0b01111101, 0b01111101, 0b01111101, 0b00000001, 0b11111111, 0b11111111, 0xFF, 0xFF, 0xFF, 0xFF, 0xFF, 0xFF, 0xFF, 0xFF, 0xFF, 0xFF
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 .db  0xFF, 0xFF, 0xFF, 0xFF, 0xFF, 0xFF, 0xFF, 0xFF, 0xFF, 0xFF, 0xFF, 0xFF, 0xFF, 0xFF, 0xFF, 0xFF

.ORG 0x880
;Row 1 data:
;       
 .db  0b01111001, 0b11100111, 0b01111101, 0b11111101, 0b11110011, 0b01111111, 0b01111111, 0b01111101, 0b01111101, 0b01111101, 0b01111101, 0b01111101, 0b01111111, 0b01111101, 0b01111111, 0b01111111
 .db  0b01111111, 0b01111101, 0b11101111, 0b11110111, 0b01101111, 0b01111111, 0b01010101, 0b00111101, 0b01111101, 0b01111101, 0b01111101, 0b01111101, 0b01111111, 0b11101111, 0b01111101, 0b01111101
 .db  0b01111101, 0b10111011, 0b10111011, 0b11111011, 0b11111111, 0b11111111, 0xFF, 0xFF, 0xFF, 0xFF, 0xFF, 0xFF, 0xFF, 0xFF, 0xFF, 0xFF
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 .db  0xFF, 0xFF, 0xFF, 0xFF, 0xFF, 0xFF, 0xFF, 0xFF, 0xFF, 0xFF, 0xFF, 0xFF, 0xFF, 0xFF, 0xFF, 0xFF

.ORG 0x900
;Row 2 data:
;       
 .db  0b01110101, 0b11010111, 0b11111011, 0b11111011, 0b11101011, 0b01111111, 0b01111111, 0b11111011, 0b01111101, 0b01111101, 0b01111101, 0b01111101, 0b01111111, 0b01111101, 0b01111111, 0b01111111
 .db  0b01111111, 0b01111101, 0b11101111, 0b11110111, 0b01011111, 0b01111111, 0b01101101, 0b01011101, 0b01111101, 0b01111101, 0b01111101, 0b01111101, 0b01111111, 0b11101111, 0b01111101, 0b01111101
 .db  0b01111101, 0b11010111, 0b11010111, 0b11110111, 0b11111111, 0b11111111, 0xFF, 0xFF, 0xFF, 0xFF, 0xFF, 0xFF, 0xFF, 0xFF, 0xFF, 0xFF
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 .db  0xFF, 0xFF, 0xFF, 0xFF, 0xFF, 0xFF, 0xFF, 0xFF, 0xFF, 0xFF, 0xFF, 0xFF, 0xFF, 0xFF, 0xFF, 0xFF

.ORG 0x980
;Row 3 data:
;       
 .db  0b01101101, 0b11110111, 0b11110111, 0b11000111, 0b11011011, 0b00000011, 0b00000011, 0b11110111, 0b10000011, 0b10000001, 0b01111101, 0b00000011, 0b01111111, 0b01111101, 0b00000011, 0b00000011
 .db  0b01110001, 0b00000001, 0b11101111, 0b11110111, 0b00111111, 0b01111111, 0b01111101, 0b01101101, 0b01111101, 0b00000011, 0b01111101, 0b00000011, 0b00000011, 0b11101111, 0b01111101, 0b01111101
 .db  0b01111101, 0b11101111, 0b11101111, 0b11101111, 0b11111111, 0b00000001, 0xFF, 0xFF, 0xFF, 0xFF, 0xFF, 0xFF, 0xFF, 0xFF, 0xFF, 0xFF
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 .db  0xFF, 0xFF, 0xFF, 0xFF, 0xFF, 0xFF, 0xFF, 0xFF, 0xFF, 0xFF, 0xFF, 0xFF, 0xFF, 0xFF, 0xFF, 0xFF

.ORG 0xA00
;Row 4 data:
;       
 .db  0b01011101, 0b11110111, 0b11101111, 0b11111011, 0b10111011, 0b11111101, 0b01111101, 0b11101111, 0b01111101, 0b11111101, 0b00000001, 0b01111101, 0b01111111, 0b01111101, 0b01111111, 0b01111111
 .db  0b01111101, 0b01111101, 0b11101111, 0b11110111, 0b01011111, 0b01111111, 0b01111101, 0b01110101, 0b01111101, 0b01111111, 0b01110101, 0b01110111, 0b11111101, 0b11101111, 0b01111101, 0b10111011
 .db  0b01101101, 0b11010111, 0b11101111, 0b11011111, 0b11111111, 0b11111111, 0xFF, 0xFF, 0xFF, 0xFF, 0xFF, 0xFF, 0xFF, 0xFF, 0xFF, 0xFF
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 .db  0xFF, 0xFF, 0xFF, 0xFF, 0xFF, 0xFF, 0xFF, 0xFF, 0xFF, 0xFF, 0xFF, 0xFF, 0xFF, 0xFF, 0xFF, 0xFF

.ORG 0xA80
;Row 5 data:
;       
 .db  0b00111101, 0b11110111, 0b11011111, 0b11111101, 0b00000001, 0b11111101, 0b01111101, 0b11011111, 0b01111101, 0b11111101, 0b01111101, 0b01111101, 0b01111111, 0b01111101, 0b01111111, 0b01111111
 .db  0b01111101, 0b01111101, 0b11101111, 0b01110111, 0b01101111, 0b01111111, 0b01111101, 0b01111001, 0b01111101, 0b01111111, 0b01111001, 0b01111011, 0b11111101, 0b11101111, 0b01111101, 0b11010111
 .db  0b01010101, 0b01111011, 0b11101111, 0b10111111, 0b11111111, 0b11111111, 0xFF, 0xFF, 0xFF, 0xFF, 0xFF, 0xFF, 0xFF, 0xFF, 0xFF, 0xFF
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 .db  0xFF, 0xFF, 0xFF, 0xFF, 0xFF, 0xFF, 0xFF, 0xFF, 0xFF, 0xFF, 0xFF, 0xFF, 0xFF, 0xFF, 0xFF, 0xFF

.ORG 0xB00
;Row 6 data:
;       
 .db  0b10000011, 0b11100011, 0b10000001, 0b10000011, 0b11111011, 0b10000011, 0b10000011, 0b10111111, 0b10000011, 0b10000011, 0b01111101, 0b00000011, 0b10000011, 0b00000011, 0b00000001, 0b01111111
 .db  0b10000011, 0b01111101, 0b10000011, 0b10001111, 0b01110111, 0b00000011, 0b01111101, 0b01111101, 0b10000011, 0b01111111, 0b10000011, 0b01111101, 0b00000011, 0b11101111, 0b10000011, 0b11101111
 .db  0b00111001, 0b01111101, 0b11101111, 0b00000001, 0b11111111, 0b11111111, 0xFF, 0xFF, 0xFF, 0xFF, 0xFF, 0xFF, 0xFF, 0xFF, 0xFF, 0xFF
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 .db  0xFF, 0xFF, 0xFF, 0xFF, 0xFF, 0xFF, 0xFF, 0xFF, 0xFF, 0xFF, 0xFF, 0xFF, 0xFF, 0xFF, 0xFF, 0xFF

.ORG 0xB80
;Row 7 data:
;       don't change any thing here
              
 .db  0xFF, 0xFF, 0xFF, 0xFF, 0xFF, 0xFF, 0xFF, 0xFF, 0xFF, 0xFF, 0xFF, 0xFF, 0xFF, 0xFF, 0xFF, 0xFF
 .db  0xFF, 0xFF, 0xFF, 0xFF, 0xFF, 0xFF, 0xFF, 0xFF, 0xFF, 0xFF, 0xFF, 0xFF, 0xFF, 0xFF, 0xFF, 0xFF
 .db  0xFF, 0xFF, 0xFF, 0xFF, 0xFF, 0xFF, 0xFF, 0xFF, 0xFF, 0xFF, 0xFF, 0xFF, 0xFF, 0xFF, 0xFF, 0xFF
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 .db  0xFF, 0xFF, 0xFF, 0xFF, 0xFF, 0xFF, 0xFF, 0xFF, 0xFF, 0xFF, 0xFF, 0xFF, 0xFF, 0xFF, 0xFF, 0xFF
;
;
; End
;